GOSUB greet
ENDDO

SUBROUTINE greet
(
  PRINT "hello"
  RETURN
)
